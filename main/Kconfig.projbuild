## main/Kconfig.projbuild
```kconfig
menu "esp32-mqtt-client"


config WIFI_SSID
    string "the ssid of the wireless network to connect to"
    default "myssid"

config WIFI_PASS
    string "the passphrase for the specified network"
    default "mypassword"



config MQTT_BROKER
    string "mqtt broker to connect to"
    default "broker.shiftr.io"

config MQTT_PORT
    int "mqtt broker port"
    default 1883

config MQTT_USER
    string "mqtt broker username"
    default "try"

config MQTT_PASS
    string "mqtt broker passphrase"
    default "try"


config LED_GPIO
    int "led gpio number"
	range 0 34
	default 5
    help
		GPIO number (IOxx) to blink on and off.

		Some GPIOs are used for other purposes (flash connections, etc.) and cannot be used to blink.

		GPIOs 35-39 are input-only so cannot be used as outputs.


endmenu
```
